/*
 * The panel is a chain of four SCT2024 16-bit shift registers. A frame is
 * 256 bits shifted in MSB first; the order in which the LEDs are chained is
 * described by positions[] (taken from github.com/ph1p/ikea-led-obegraensad).
 */

#include <string.h>
#include <zephyr/kernel.h>
#include <zephyr/drivers/spi.h>
#include <zephyr/drivers/pwm.h>

#include "panel.h"

#define PANEL DT_NODELABEL(obegraensad)

static const struct spi_dt_spec spi =
	SPI_DT_SPEC_GET(PANEL, SPI_OP_MODE_MASTER | SPI_WORD_SET(8) | SPI_TRANSFER_MSB);
static const struct pwm_dt_spec en = PWM_DT_SPEC_GET(PANEL);

/* positions[n] is the pixel (row * PANEL_COLS + col) driven by the n-th bit shifted in */
static const uint8_t positions[PANEL_ROWS * PANEL_COLS] = {
	0x0f, 0x0e, 0x0d, 0x0c, 0x0b, 0x0a, 0x09, 0x08, 0x18, 0x19, 0x1a, 0x1b, 0x1c, 0x1d, 0x1e, 0x1f,
	0x07, 0x06, 0x05, 0x04, 0x03, 0x02, 0x01, 0x00, 0x10, 0x11, 0x12, 0x13, 0x14, 0x15, 0x16, 0x17,
	0x27, 0x26, 0x25, 0x24, 0x23, 0x22, 0x21, 0x20, 0x30, 0x31, 0x32, 0x33, 0x34, 0x35, 0x36, 0x37,
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	0xef, 0xee, 0xed, 0xec, 0xeb, 0xea, 0xe9, 0xe8, 0xf8, 0xf9, 0xfa, 0xfb, 0xfc, 0xfd, 0xfe, 0xff,
};

static bool fb[PANEL_ROWS][PANEL_COLS];

int panel_init(void)
{
	if (!spi_is_ready_dt(&spi) || !pwm_is_ready_dt(&en)) {
		return -ENODEV;
	}

	/* Clear the shift registers before enabling the outputs */
	panel_brightness(0);
	panel_clear();
	return panel_show();
}

void panel_clear(void)
{
	memset(fb, 0, sizeof(fb));
}

void panel_set(int x, int y, bool on)
{
	if (x >= 0 && x < PANEL_COLS && y >= 0 && y < PANEL_ROWS) {
		fb[y][x] = on;
	}
}

int panel_show(void)
{
	uint8_t bits[PANEL_ROWS * PANEL_COLS / 8] = {0};

	for (int i = 0; i < PANEL_ROWS * PANEL_COLS; i++) {
		uint8_t p = positions[i];

		if (fb[p / PANEL_COLS][p % PANEL_COLS]) {
			bits[i / 8] |= 0x80 >> (i % 8);
		}
	}

	const struct spi_buf buf = {.buf = bits, .len = sizeof(bits)};
	const struct spi_buf_set tx = {.buffers = &buf, .count = 1};

	/* CS (CLA) is low while shifting and goes high afterwards, latching the frame */
	return spi_write_dt(&spi, &tx);
}

int panel_brightness(uint8_t percent)
{
	return pwm_set_pulse_dt(&en, en.period * percent / 100);
}
